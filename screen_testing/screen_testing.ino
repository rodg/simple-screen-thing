/**************************************************************************
 This is an example for our Monochrome OLEDs based on SSD1306 drivers

 Pick one up today in the adafruit shop!
 ------> http://www.adafruit.com/category/63_98

 This example is for a 128x32 pixel display using I2C to communicate
 3 pins are required to interface (two I2C and one reset).

 Adafruit invests time and resources providing this open
 source code, please support Adafruit and open-source
 hardware by purchasing products from Adafruit!

 Written by Limor Fried/Ladyada for Adafruit Industries,
 with contributions from the open source community.
 BSD license, check license.txt for more information
 All text above, and the splash screen below must be
 included in any redistribution.
 **************************************************************************/

#include <SPI.h>
#include <Wire.h>
#include <Adafruit_GFX.h>
#include <Adafruit_SSD1306.h>
#include <neopixel_blit.h>
#include <serial_interface.h>


#define SCREEN_WIDTH 128 // OLED display width, in pixels
#define SCREEN_HEIGHT 64 // OLED display height, in pixels

// Declaration for an SSD1306 display connected to I2C (SDA, SCL pins)
#define OLED_RESET     -1 // Reset pin # (or -1 if sharing Arduino reset pin)
Adafruit_SSD1306 display(SCREEN_WIDTH, SCREEN_HEIGHT, &Wire, OLED_RESET);

#define NUMFLAKES     10 // Number of snowflakes in the animation example

#define LOGO_HEIGHT   64
#define LOGO_WIDTH    128
static const unsigned char PROGMEM logo_bmp[] =
{ 0x0,
0x0, 0x0, 0x0, 0x0, 0x0, 0x0, 0x0, 0x0,
0x0, 0x0, 0x0, 0x0, 0x0, 0x0, 0x0, 0x0,
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0x0, 0x0, 0x0, 0x0, 0x0, 0x0, 0x0 };
/*
{ 0x0,
0x0, 0x0, 0x0, 0x7, 0xc0, 0x0, 0x0, 0x0,
0x0, 0x0, 0x3, 0x9f, 0xfe, 0x0, 0x0, 0x0,
0x0, 0x0, 0xff, 0xff, 0xff, 0x0, 0x0, 0x0,
0x0, 0xf, 0xff, 0xff, 0xff, 0xf0, 0x0, 0x0,
0x0, 0x1f, 0xff, 0xff, 0xff, 0xfe, 0x0, 0x0,
0x0, 0x7f, 0xff, 0xff, 0xff, 0xff, 0x0, 0x0,
0x0, 0xff, 0xff, 0xff, 0x3f, 0xff, 0x80, 0x0,
0x1, 0xff, 0xff, 0xff, 0xff, 0xff, 0x80, 0x0,
0x3, 0xff, 0xff, 0xff, 0xff, 0xff, 0x80, 0x0,
0x7, 0xff, 0xff, 0xff, 0xff, 0xff, 0x80, 0x0,
0xf, 0xff, 0xff, 0xff, 0xff, 0xff, 0x80, 0x0,
0x1f, 0xff, 0xff, 0xff, 0xff, 0xff, 0x0, 0x0,
0x3f, 0xff, 0xff, 0xff, 0xff, 0xff, 0x0, 0x0,
0xff, 0xff, 0xff, 0xff, 0xff, 0xff, 0x0, 0x3,
0xff, 0xff, 0xff, 0xff, 0xff, 0xff, 0x0, 0x7,
0xff, 0xff, 0xff, 0xff, 0xff, 0xe0, 0x0, 0x1f,
0xff, 0xff, 0xff, 0xff, 0xff, 0xf8, 0x0, 0x3f,
0xff, 0xff, 0xff, 0xff, 0xff, 0xfc, 0x0, 0x3f,
0xff, 0xff, 0xff, 0xff, 0xff, 0xff, 0x0, 0x3f,
0xff, 0xff, 0xff, 0xff, 0xff, 0xff, 0x80, 0x3f,
0xff, 0xfe, 0x0, 0x1f, 0xcf, 0x3, 0xc0, 0x3f,
0xff, 0xfd, 0xff, 0xdf, 0xdf, 0xfb, 0xe0, 0x3f,
0xff, 0xfd, 0xff, 0xdf, 0xbf, 0xfb, 0xe0, 0x3f,
0xff, 0xfd, 0xff, 0xdf, 0x7f, 0xfb, 0xf0, 0x1f,
0xff, 0xfd, 0xff, 0xff, 0x7f, 0xf7, 0xf8, 0x1f,
0xff, 0xfd, 0xff, 0xee, 0xff, 0xef, 0xfc, 0x1f,
0xff, 0xfd, 0xff, 0xee, 0xff, 0xef, 0xfc, 0xf,
0xff, 0xfd, 0xff, 0xed, 0xff, 0xef, 0xfc, 0x7,
0xff, 0xfd, 0xff, 0xed, 0xff, 0xdf, 0xfc, 0x7,
0xff, 0xfd, 0xff, 0xeb, 0xff, 0xff, 0xfc, 0x7,
0xff, 0xff, 0xff, 0xef, 0xff, 0xff, 0xf8, 0x7,
0xff, 0xff, 0xf3, 0xff, 0x3f, 0xff, 0xf8, 0x3,
0xff, 0xfb, 0xfb, 0xfe, 0xbf, 0xff, 0xf8, 0x3,
0xff, 0xfb, 0xeb, 0xfe, 0xbf, 0xff, 0xf0, 0x1,
0xff, 0xff, 0xeb, 0xfd, 0xbf, 0xff, 0xe0, 0x1,
0xff, 0xf7, 0xef, 0xfd, 0xff, 0xff, 0xc0, 0x0,
0xff, 0xf7, 0xfd, 0xfb, 0x7f, 0xbf, 0x80, 0x0,
0xff, 0xf7, 0xdd, 0xfb, 0x7f, 0x7f, 0x0, 0x0,
0x7f, 0xf7, 0xdd, 0xf7, 0x7f, 0x7c, 0x0, 0x0,
0x3f, 0xef, 0xdd, 0xf7, 0xff, 0x70, 0x0, 0x0,
0x3f, 0xcf, 0xdd, 0xee, 0xff, 0x78, 0x0, 0x0,
0x1f, 0xdf, 0xfd, 0xfd, 0xff, 0xbc, 0x0, 0x0,
0x1f, 0xdf, 0xdd, 0xdd, 0xff, 0x7c, 0x0, 0x0,
0x1f, 0xbf, 0xdf, 0xbf, 0xff, 0x7e, 0x0, 0x0,
0x1f, 0x80, 0x1e, 0x38, 0x0, 0x7f, 0x0, 0x0,
0x1f, 0xff, 0xff, 0xff, 0xff, 0xff, 0x0, 0x0,
0x1f, 0xff, 0xff, 0xff, 0xff, 0xff, 0x0, 0x0,
0x1f, 0xff, 0xff, 0xff, 0xff, 0xff, 0x0, 0x0,
0x3f, 0xff, 0xff, 0xff, 0xff, 0xff, 0x0, 0x0,
0x7f, 0xff, 0xff, 0xfc, 0xff, 0xff, 0x0, 0x0,
0xff, 0xff, 0xff, 0xf0, 0x7f, 0xff, 0x0, 0x0,
0xff, 0xff, 0xf0, 0x0, 0x7f, 0xff, 0x0, 0x1,
0xff, 0xff, 0xe0, 0x0, 0x3f, 0xff, 0x80, 0x3,
0xff, 0xff, 0x80, 0x0, 0x3f, 0xff, 0x80, 0x3,
0xff, 0xff, 0x0, 0x0, 0x3f, 0xff, 0xc0, 0x7,
0xff, 0xfe, 0x0, 0x0, 0x3f, 0xff, 0xc0, 0xf,
0xff, 0xfc, 0x0, 0x0, 0x7f, 0xff, 0xc0, 0xf,
0xff, 0xfc, 0x0, 0x0, 0xff, 0xff, 0xe0, 0xf,
0xff, 0xf8, 0x0, 0x0, 0xff, 0xff, 0xc0, 0x3,
0xb8, 0x20, 0x0, 0x0, 0x0, 0x2, 0x0};*/
/*
{ 0x0,
0x0, 0x0, 0x0, 0x7, 0xc0, 0x0, 0x0, 0x0,
0x0, 0x0, 0x3, 0x9f, 0xfe, 0x0, 0x0, 0x0,
0x0, 0x0, 0xff, 0xff, 0xcf, 0x0, 0x0, 0x0,
0x0, 0xf, 0xf8, 0x7f, 0xfd, 0xf0, 0x0, 0x0,
0x0, 0x1f, 0xe1, 0x7f, 0x7f, 0xfe, 0x0, 0x0,
0x0, 0x7f, 0xcf, 0xff, 0xdf, 0xff, 0x0, 0x0,
0x0, 0xff, 0x9f, 0xff, 0x3f, 0xff, 0x80, 0x0,
0x1, 0xff, 0x3f, 0xff, 0xff, 0xff, 0x80, 0x0,
0x3, 0xff, 0x7f, 0xff, 0xff, 0xff, 0x80, 0x0,
0x7, 0xfe, 0x7f, 0xff, 0xff, 0xff, 0x80, 0x0,
0xf, 0xfe, 0xfb, 0xff, 0xff, 0xfd, 0x80, 0x0,
0x1f, 0xfd, 0xf7, 0xff, 0xff, 0xff, 0x0, 0x0,
0x3f, 0xff, 0xef, 0xfe, 0xff, 0xff, 0x0, 0x0,
0xff, 0xff, 0xdf, 0xfe, 0xff, 0xff, 0x0, 0x3,
0xff, 0xff, 0xff, 0xff, 0xff, 0xff, 0x0, 0x7,
0xff, 0xff, 0xff, 0xff, 0x7f, 0xe0, 0x0, 0x1f,
0xff, 0xff, 0xff, 0xf7, 0xbf, 0xf8, 0x0, 0x3f,
0xff, 0xff, 0xff, 0xff, 0xff, 0xfc, 0x0, 0x3f,
0xff, 0xff, 0xff, 0xff, 0xff, 0xdf, 0x0, 0x3f,
0xfb, 0xff, 0xff, 0xff, 0xff, 0x7f, 0x80, 0x3f,
0xfd, 0xfe, 0x0, 0x1f, 0xcf, 0x3, 0xc0, 0x3f,
0xfd, 0xfd, 0xff, 0xdf, 0xdf, 0xfb, 0x60, 0x3f,
0xfe, 0xfd, 0xff, 0xdf, 0xbf, 0xfb, 0xa0, 0x3f,
0xff, 0xfd, 0xff, 0xdf, 0x7f, 0xfb, 0xf0, 0x1f,
0xff, 0x7d, 0xff, 0xff, 0x7f, 0xf7, 0xd8, 0x1f,
0xff, 0x1d, 0xff, 0xee, 0xff, 0xef, 0xec, 0x1f,
0xff, 0xfd, 0xff, 0xee, 0xff, 0xef, 0xfc, 0xf,
0xff, 0xf5, 0xff, 0xed, 0xff, 0xef, 0xfc, 0x7,
0xff, 0xfd, 0xff, 0xed, 0xff, 0xdf, 0xfc, 0x7,
0xff, 0xfd, 0xff, 0xeb, 0xff, 0xff, 0xec, 0x7,
0xff, 0xff, 0xff, 0xeb, 0xff, 0xff, 0xe8, 0x7,
0xff, 0xff, 0xf3, 0xff, 0x3f, 0xff, 0xd8, 0x3,
0xff, 0xfb, 0xeb, 0xfe, 0xbf, 0xff, 0xf8, 0x3,
0xfb, 0xfb, 0xeb, 0xfe, 0xbf, 0xff, 0xf0, 0x1,
0xff, 0xff, 0xeb, 0xfd, 0xbf, 0xff, 0xe0, 0x1,
0xfb, 0xf7, 0xef, 0xfd, 0xff, 0xff, 0xc0, 0x0,
0xfb, 0xf7, 0xfd, 0xfb, 0x7f, 0xbf, 0x80, 0x0,
0xfb, 0xf7, 0xdd, 0xfb, 0x7f, 0x7f, 0x0, 0x0,
0x73, 0xf7, 0xdd, 0xf7, 0x7f, 0x7c, 0x0, 0x0,
0x31, 0xef, 0xdd, 0xf7, 0xff, 0x70, 0x0, 0x0,
0x39, 0xcf, 0xdd, 0xee, 0xff, 0x78, 0x0, 0x0,
0x19, 0xdf, 0xfd, 0xcd, 0xff, 0x9c, 0x0, 0x0,
0x1b, 0xdf, 0xdd, 0xdd, 0xff, 0x6c, 0x0, 0x0,
0x1f, 0xbf, 0xdf, 0xbd, 0xff, 0x76, 0x0, 0x0,
0x1f, 0x80, 0x1e, 0x38, 0x0, 0x7f, 0x0, 0x0,
0x1f, 0xff, 0xff, 0xff, 0xff, 0xfb, 0x0, 0x0,
0x1f, 0xff, 0xff, 0xff, 0xff, 0xfb, 0x0, 0x0,
0x1f, 0xff, 0xfd, 0xe7, 0xff, 0xf7, 0x0, 0x0,
0x3f, 0xff, 0xbf, 0xff, 0xff, 0xff, 0x0, 0x0,
0x7f, 0xff, 0xff, 0xfc, 0xff, 0xff, 0x0, 0x0,
0xff, 0xff, 0xff, 0xf0, 0x7f, 0xff, 0x0, 0x0,
0xff, 0xff, 0xf0, 0x0, 0x7f, 0xff, 0x0, 0x1,
0xff, 0xff, 0xe0, 0x0, 0x3f, 0xff, 0x80, 0x3,
0xff, 0xff, 0x80, 0x0, 0x3f, 0xff, 0x80, 0x3,
0xff, 0xff, 0x0, 0x0, 0x3f, 0xff, 0xc0, 0x7,
0xff, 0xfe, 0x0, 0x0, 0x3f, 0xff, 0xc0, 0xf,
0xcc, 0xfc, 0x0, 0x0, 0x7f, 0x91, 0x40, 0x8,
0xc8, 0x78, 0x0, 0x0, 0xff, 0x81, 0x20, 0xc,
0xff, 0xf8, 0x0, 0x0, 0xff, 0xff, 0xc0, 0x3,
0xb8, 0x20, 0x0, 0x0, 0x0, 0x2, 0x0};*/
/*{ 0b00000000, B11000000,
  B00000001, B11000000,
  B00000001, B11000000,
  B00000011, B11100000,
  B11110011, B11100000,
  B11111110, B11111000,
  B01111110, B11111111,
  B00110011, B10011111,
  B00011111, B11111100,
  B00001101, B01110000,
  B00011011, B10100000,
  B00111111, B11100000,
  B00111111, B11110000,
  B01111100, B11110000,
  B01110000, B01110000,
  B00000000, B00110000 };*/

void setup() {
  Serial.begin(9600);

  // SSD1306_SWITCHCAPVCC = generate display voltage from 3.3V internally
  if(!display.begin(SSD1306_SWITCHCAPVCC, 0x3C)) { // Address 0x3D for 128x64
    Serial.println(F("SSD1306 allocation failed"));
    for(;;); // Don't proceed, loop forever
  }

  // Show initial display buffer contents on the screen --
  // the library initializes this with an Adafruit splash screen.
  display.display();
  delay(500); // Pause for 2 seconds

  // Clear the buffer
  display.clearDisplay();
  testdrawbitmap();
  // Draw a single pixel in white
  //display.drawPixel(10, 10, WHITE);

  // Show the display buffer on the screen. You MUST call display() after
  // drawing commands to make them visible on screen!
  //display.display();
  //delay(2000);
  // display.display() is NOT necessary after every single drawing command,
  // unless that's what you want...rather, you can batch up a bunch of
  // drawing operations and then update the screen all at once by calling
  // display.display(). These examples demonstrate both approaches...
}

int i, left = 4, right = 19;
int16_t d = 3;
int width = 128, height = 64, pad_w = 25, pad_h = 4;
bool rWasDown, lWasDown;
int16_t bx = 20, by = 20, xspeed = 2, yspeed = 2, radius = 3;


void loop() {
  display.clearDisplay();
  if(bx+xspeed+radius>128 || bx+xspeed-radius<0){
    xspeed *= -1;  
  }

  if(by+yspeed+radius>64 || by+yspeed-radius<0){
    yspeed *= -1;  
  }
  by = by + yspeed;
  bx = bx + xspeed;

  display.fillCircle(bx, by, radius, WHITE);
  if(digitalRead(left)){
      d += 3;
  }

  if(digitalRead(right)){
      d -= 3;
  }
  drawpaddle(d);
}

void drawpaddle(int16_t x){
  display.fillRect(x, 4, pad_w, pad_h, WHITE);
  display.display();
}

void testdrawline() {
  int16_t i;

  display.clearDisplay(); // Clear display buffer

  for(i=0; i<display.width(); i+=4) {
    display.drawLine(0, 0, i, display.height()-1, WHITE);
    display.display(); // Update screen with each newly-drawn line
    delay(1);
  }
  for(i=0; i<display.height(); i+=4) {
    display.drawLine(0, 0, display.width()-1, i, WHITE);
    display.display();
    delay(1);
  }
  delay(250);

  display.clearDisplay();

  for(i=0; i<display.width(); i+=4) {
    display.drawLine(0, display.height()-1, i, 0, WHITE);
    display.display();
    delay(1);
  }
  for(i=display.height()-1; i>=0; i-=4) {
    display.drawLine(0, display.height()-1, display.width()-1, i, WHITE);
    display.display();
    delay(1);
  }
  delay(250);

  display.clearDisplay();

  for(i=display.width()-1; i>=0; i-=4) {
    display.drawLine(display.width()-1, display.height()-1, i, 0, WHITE);
    display.display();
    delay(1);
  }
  for(i=display.height()-1; i>=0; i-=4) {
    display.drawLine(display.width()-1, display.height()-1, 0, i, WHITE);
    display.display();
    delay(1);
  }
  delay(250);

  display.clearDisplay();

  for(i=0; i<display.height(); i+=4) {
    display.drawLine(display.width()-1, 0, 0, i, WHITE);
    display.display();
    delay(1);
  }
  for(i=0; i<display.width(); i+=4) {
    display.drawLine(display.width()-1, 0, i, display.height()-1, WHITE);
    display.display();
    delay(1);
  }

  delay(2000); // Pause for 2 seconds
}

void testdrawrect(void) {
  display.clearDisplay();

  for(int16_t i=0; i<display.height()/2; i+=2) {
    display.drawRect(i, i, display.width()-2*i, display.height()-2*i, WHITE);
    display.display(); // Update screen with each newly-drawn rectangle
    delay(1);
  }

  delay(2000);
}

void testfillrect(void) {
  display.clearDisplay();

  for(int16_t i=0; i<display.height()/2; i+=3) {
    // The INVERSE color is used so rectangles alternate white/black
    display.fillRect(i, i, display.width()-i*2, display.height()-i*2, INVERSE);
    display.display(); // Update screen with each newly-drawn rectangle
    delay(1);
  }

  delay(2000);
}

void testdrawcircle(void) {
  display.clearDisplay();

  for(int16_t i=0; i<max(display.width(),display.height())/2; i+=2) {
    display.drawCircle(display.width()/2, display.height()/2, i, WHITE);
    display.display();
    delay(1);
  }

  delay(2000);
}

void testfillcircle(void) {
  display.clearDisplay();

  for(int16_t i=max(display.width(),display.height())/2; i>0; i-=3) {
    // The INVERSE color is used so circles alternate white/black
    display.fillCircle(display.width() / 2, display.height() / 2, i, INVERSE);
    display.display(); // Update screen with each newly-drawn circle
    delay(1);
  }

  delay(2000);
}

void testdrawroundrect(void) {
  display.clearDisplay();

  for(int16_t i=0; i<display.height()/2-2; i+=2) {
    display.drawRoundRect(i, i, display.width()-2*i, display.height()-2*i,
      display.height()/4, WHITE);
    display.display();
    delay(1);
  }

  delay(2000);
}

void testfillroundrect(void) {
  display.clearDisplay();

  for(int16_t i=0; i<display.height()/2-2; i+=2) {
    // The INVERSE color is used so round-rects alternate white/black
    display.fillRoundRect(i, i, display.width()-2*i, display.height()-2*i,
      display.height()/4, INVERSE);
    display.display();
    delay(1);
  }

  delay(2000);
}

void testdrawtriangle(void) {
  display.clearDisplay();

  for(int16_t i=0; i<max(display.width(),display.height())/2; i+=5) {
    display.drawTriangle(
      display.width()/2  , display.height()/2-i,
      display.width()/2-i, display.height()/2+i,
      display.width()/2+i, display.height()/2+i, WHITE);
    display.display();
    delay(1);
  }

  delay(2000);
}

void testfilltriangle(void) {
  display.clearDisplay();

  for(int16_t i=max(display.width(),display.height())/2; i>0; i-=5) {
    // The INVERSE color is used so triangles alternate white/black
    display.fillTriangle(
      display.width()/2  , display.height()/2-i,
      display.width()/2-i, display.height()/2+i,
      display.width()/2+i, display.height()/2+i, INVERSE);
    display.display();
    delay(1);
  }

  delay(2000);
}

void testdrawchar(void) {
  display.clearDisplay();

  display.setTextSize(1);      // Normal 1:1 pixel scale
  display.setTextColor(WHITE); // Draw white text
  display.setCursor(0, 0);     // Start at top-left corner
  display.cp437(true);         // Use full 256 char 'Code Page 437' font

  // Not all the characters will fit on the display. This is normal.
  // Library will draw what it can and the rest will be clipped.
  for(int16_t i=0; i<256; i++) {
    if(i == '\n') display.write(' ');
    else          display.write(i);
  }

  display.display();
  delay(2000);
}

void testdrawstyles(void) {
  display.clearDisplay();

  display.setTextSize(1);             // Normal 1:1 pixel scale
  display.setTextColor(WHITE);        // Draw white text
  display.setCursor(0,0);             // Start at top-left corner
  display.println(F("Hello, world!"));

  display.setTextColor(BLACK, WHITE); // Draw 'inverse' text
  display.println(3.141592);

  display.setTextSize(2);             // Draw 2X-scale text
  display.setTextColor(WHITE);
  display.print(F("0x")); display.println(0xDEADBEEF, HEX);

  display.display();
  delay(2000);
}

void testscrolltext(void) {
  display.clearDisplay();

  display.setTextSize(2); // Draw 2X-scale text
  display.setTextColor(WHITE);
  display.setCursor(10, 0);
  display.println(F("scroll"));
  display.display();      // Show initial text
  delay(100);

  // Scroll in various directions, pausing in-between:
  display.startscrollright(0x00, 0x0F);
  delay(2000);
  display.stopscroll();
  delay(1000);
  display.startscrollleft(0x00, 0x0F);
  delay(2000);
  display.stopscroll();
  delay(1000);
  display.startscrolldiagright(0x00, 0x07);
  delay(2000);
  display.startscrolldiagleft(0x00, 0x07);
  delay(2000);
  display.stopscroll();
  delay(1000);
}

void testdrawbitmap(void) {
  display.clearDisplay();

  display.drawBitmap(
    (display.width()  - LOGO_WIDTH ) / 2,
    (display.height() - LOGO_HEIGHT) / 2,
    logo_bmp, LOGO_WIDTH, LOGO_HEIGHT, 1);
  display.display();
  delay(2000);
}

#define XPOS   0 // Indexes into the 'icons' array in function below
#define YPOS   1
#define DELTAY 2

void testanimate(const uint8_t *bitmap, uint8_t w, uint8_t h) {
  int8_t f, icons[NUMFLAKES][3];

  // Initialize 'snowflake' positions
  for(f=0; f< NUMFLAKES; f++) {
    icons[f][XPOS]   = random(1 - LOGO_WIDTH, display.width());
    icons[f][YPOS]   = -LOGO_HEIGHT;
    icons[f][DELTAY] = random(1, 6);
    Serial.print(F("x: "));
    Serial.print(icons[f][XPOS], DEC);
    Serial.print(F(" y: "));
    Serial.print(icons[f][YPOS], DEC);
    Serial.print(F(" dy: "));
    Serial.println(icons[f][DELTAY], DEC);
  }

  for(;;) { // Loop forever...
    display.clearDisplay(); // Clear the display buffer

    // Draw each snowflake:
    for(f=0; f< NUMFLAKES; f++) {
      display.drawBitmap(icons[f][XPOS], icons[f][YPOS], bitmap, w, h, WHITE);
    }

    display.display(); // Show the display buffer on the screen
    delay(200);        // Pause for 1/10 second

    // Then update coordinates of each flake...
    for(f=0; f< NUMFLAKES; f++) {
      icons[f][YPOS] += icons[f][DELTAY];
      // If snowflake is off the bottom of the screen...
      if (icons[f][YPOS] >= display.height()) {
        // Reinitialize to a random position, just off the top
        icons[f][XPOS]   = random(1 - LOGO_WIDTH, display.width());
        icons[f][YPOS]   = -LOGO_HEIGHT;
        icons[f][DELTAY] = random(1, 6);
      }
    }
  }
}
